## sdkconfig.defaults
```kconfig
CONFIG_BT_ENABLED=y
CONFIG_BT_NIMBLE_ENABLED=y
CONFIG_BT_CLASSIC_ENABLED=n
CONFIG_BT_NIMBLE_ROLE_PERIPHERAL=y
CONFIG_BT_NIMBLE_MAX_CONNECTIONS=1
CONFIG_BT_NIMBLE_GATT_MAX_PROCS=4
CONFIG_BT_NIMBLE_ATT_PREFERRED_MTU=128
CONFIG_BT_NIMBLE_NVS_PERSIST=y
CONFIG_BT_NIMBLE_LOG_LEVEL_WARNING=y
CONFIG_BT_NIMBLE_MSYS_1_BLOCK_COUNT=24
CONFIG_BT_NIMBLE_MSYS_2_BLOCK_COUNT=48
CONFIG_BLE_REQUEST_CONNECTION_UPDATE=y
CONFIG_BLE_CONNECTION_UPDATE_DELAY_MS=100
CONFIG_BLE_CONN_INTERVAL_MIN_UNITS=12
CONFIG_BLE_CONN_INTERVAL_MAX_UNITS=24
CONFIG_BLE_CONN_LATENCY=0
CONFIG_BLE_CONN_SUPERVISION_TIMEOUT_UNITS=600

CONFIG_ESP_MAIN_TASK_STACK_SIZE=3000
CONFIG_ESP_TASK_WDT=n
CONFIG_ICM_20948_USE_DMP=n
CONFIG_I2C_MASTER_SCL=7
CONFIG_I2C_MASTER_SDA=6


CONFIG_TARGET_BOARD_XIAO_ESP32_C3=y
CONFIG_IMU_RATE_HZ=120
CONFIG_IMU_SLOW_RATE_HZ=25
CONFIG_BATTERY_STATUS_PERIOD_MS=1000
CONFIG_POWER_LATCH_TEST_MODE=n
```
